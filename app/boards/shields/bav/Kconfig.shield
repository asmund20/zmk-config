## app/boards/shields/bav/Kconfig.shield
```kconfig
config SHIELD_BAV_LEFT
    def_bool $(shields_list_contains,bav_left)
config SHIELD_BAV_RIGHT
    def_bool $(shields_list_contains,bav_right)
```

## config/Kconfig.defconfig
```kconfig
/*
 * Copyright (c) 2020 The ZMK Contributors
 *
 * SPDX-License-Identifier: MIT
 */
if SHIELD_BAV_LEFT

config ZMK_KEYBOARD_NAME
    default "Bav"

config ZMK_SPLIT_ROLE_CENTRAL
    default y

endif

if SHIELD_BAV_LEFT || SHIELD_BAV_RIGHT

config ZMK_SPLIT
    default y

endif
```

## config/boards/shields/bav/Kconfig.shield
```kconfig
# Copyright (c) 2020 The ZMK Contributors
# SPDX-License-Identifier: MIT

config SHIELD_BAV_LEFT
    def_bool $(shields_list_contains,bav_left)
config SHIELD_BAV_RIGHT
    def_bool $(shields_list_contains,bav_right)
```

## config/boards/shields/keebagn/Kconfig.defconfig
```kconfig
# Copyright (c) 2020 The ZMK Contributors
# SPDX-License-Identifier: MIT

if SHIELD_KEEBAGN_LEFT

config ZMK_KEYBOARD_NAME
    default "Keebagn"

config ZMK_SPLIT_ROLE_CENTRAL
    default y

endif

if SHIELD_KEEBAGN_LEFT || SHIELD_KEEBAGN_RIGHT

config ZMK_SPLIT
    default y

endif
```

## config/boards/shields/keebagn/Kconfig.shield
```kconfig
# Copyright (c) 2020 The ZMK Contributors
# SPDX-License-Identifier: MIT

config SHIELD_KEEBAGN_LEFT
    def_bool $(shields_list_contains,keebagn_left)
config SHIELD_KEEBAGN_RIGHT
    def_bool $(shields_list_contains,keebagn_right)
```

## config/west.yml
```yaml
manifest:
  remotes:
    - name: zmkfirmware
      url-base: https://github.com/asmund20
  projects:
    - name: zmk
      remote: zmkfirmware
      revision: main
      import: app/west.yml
  self:
    path: config
```
